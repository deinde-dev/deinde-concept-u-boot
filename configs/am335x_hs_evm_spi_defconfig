## configs/am335x_hs_evm_spi_defconfig
```kconfig
#include <configs/am335x_hs_evm_defconfig>


CONFIG_SPI_BOOT=y


# CONFIG_CMD_SETEXPR is not set
```

## configs/am65x_evm_r5_usbdfu_defconfig
```kconfig
#include <configs/am65x_evm_r5_defconfig>

CONFIG_ARM=y
CONFIG_ARCH_K3=y
CONFIG_SYS_MALLOC_F_LEN=0x57000
CONFIG_SPL_GPIO=y
CONFIG_SPL_LIBCOMMON_SUPPORT=y
CONFIG_SOC_K3_AM654=y
CONFIG_K3_EARLY_CONS=y
CONFIG_TARGET_AM654_R5_EVM=y
CONFIG_HAS_CUSTOM_SYS_INIT_SP_ADDR=y
CONFIG_CUSTOM_SYS_INIT_SP_ADDR=0x41c7effc
CONFIG_ENV_SIZE=0x20000
CONFIG_DM_GPIO=y
CONFIG_DEFAULT_DEVICE_TREE="k3-am654-r5-base-board"
CONFIG_SPL_ENV_SUPPORT=y
CONFIG_CMD_DFU=y
CONFIG_SYSCON=y
CONFIG_SPL_SYSCON=y
CONFIG_SYS_DFU_DATA_BUF_SIZE=0x5000
CONFIG_SYS_DFU_MAX_FILE_SIZE=0x800000
CONFIG_MISC=y
CONFIG_PHY=y
CONFIG_SPL_PHY=y
CONFIG_OMAP_USB2_PHY=y
CONFIG_USB=y
CONFIG_DM_USB_GADGET=y
CONFIG_SPL_DM_USB_GADGET=y
CONFIG_USB_XHCI_HCD=y
CONFIG_USB_XHCI_DWC3=y
CONFIG_USB_DWC3=y
CONFIG_USB_DWC3_GENERIC=y
CONFIG_SPL_USB_DWC3_GENERIC=y
CONFIG_USB_STORAGE=y
CONFIG_USB_GADGET=y
CONFIG_SPL_USB_GADGET=y
CONFIG_USB_GADGET_MANUFACTURER="Texas Instruments"
CONFIG_USB_GADGET_VENDOR_NUM=0x0451
CONFIG_USB_GADGET_PRODUCT_NUM=0x6162
CONFIG_USB_GADGET_DOWNLOAD=y
CONFIG_SPL_DFU=y
# CONFIG_MMC is not set
# CONFIG_DMA is not set
# CONFIG_ENV_IS_IN_FAT is not set
# CONFIG_ENV_OVERWRITE is not set
# CONFIG_MTD is not set
# CONFIG_SOC_DEVICE is not set
# CONFIG_SOC_TI is not set
# CONFIG_SPI is not set
# CONFIG_SPL_DM_SPI is not set
# CONFIG_SPL_FS_FAT is not set
# CONFIG_SPL_SPI is not set
# CONFIG_TI_K3_NAVSS_UDMA is not set
CONFIG_ENV_IS_NOWHERE=y
CONFIG_SPL_ENV_IS_NOWHERE=y
```

## configs/am68_sk_r5_defconfig
```kconfig
#include <configs/j721s2_evm_r5_defconfig>

CONFIG_ARM=y
CONFIG_ARCH_K3=y
CONFIG_SOC_K3_J721S2=y
CONFIG_TARGET_J721S2_R5_EVM=y


CONFIG_SPL_DM_REGULATOR_TPS6287X=y

CONFIG_DEFAULT_DEVICE_TREE="k3-am68-sk-r5-base-board"
# CONFIG_ESM_K3 is not set
# CONFIG_ESM_PMIC is not set
# CONFIG_PMIC_TPS65941 is not set
```

## configs/am69_sk_r5_defconfig
```kconfig
#include <configs/j784s4_evm_r5_defconfig>

CONFIG_ARM=y
CONFIG_ARCH_K3=y
CONFIG_SOC_K3_J784S4=y
CONFIG_TARGET_J784S4_R5_EVM=y


CONFIG_DEFAULT_DEVICE_TREE="k3-am69-r5-sk"
# CONFIG_MULTIPLEXER is not set
# CONFIG_SPL_PCI_ENDPOINT is not set
# CONFIG_SPL_PHY is not set
```

## configs/j722s_evm_r5_ethboot_defconfig
```kconfig
#include<configs/j722s_evm_r5_defconfig>

CONFIG_ARM=y
CONFIG_ARCH_K3=y
CONFIG_SOC_K3_J722S=y
CONFIG_TARGET_J722S_R5_EVM=y
CONFIG_DEFAULT_DEVICE_TREE="k3-j722s-r5-evm"
CONFIG_SPL_DRIVERS_MISC=y
CONFIG_SPL_BOARD_INIT=y
CONFIG_SPL_DMA=y
CONFIG_SPL_ENV_SUPPORT=y
CONFIG_SPL_ETH=y
CONFIG_SPL_I2C=y
CONFIG_SPL_NET=y
CONFIG_SPL_NET_VCI_STRING="J722S U-Boot R5 SPL"
CONFIG_TI_K3_NAVSS_UDMA=y
CONFIG_TI_AM65_CPSW_NUSS=y
# CONFIG_DM_MTD is not set
# CONFIG_NO_NET is not set
# CONFIG_SPI is not set
# CONFIG_SPI_FLASH is not set
# CONFIG_SPL_DM_DEVICE_REMOVE is not set
# CONFIG_SPL_MMC is not set
# CONFIG_SPL_SPI is not set
CONFIG_ARP_TIMEOUT=5000
CONFIG_BOOTDEV_ETH=y
CONFIG_BOOTP_BOOTPATH=y
CONFIG_BOOTP_DNS=y
CONFIG_BOOTP_GATEWAY=y
CONFIG_BOOTP_HOSTNAME=y
CONFIG_BOOTP_MAX_ROOT_PATH_LEN=64
CONFIG_BOOTP_SUBNETMASK=y
CONFIG_CMD_BOOTP=y
CONFIG_CMD_NET=y
CONFIG_CMD_TFTPBOOT=y
CONFIG_DM_MDIO=y
CONFIG_MDIO_TI_CPSW=y
CONFIG_MISC_INIT_R=y
CONFIG_NET=y
CONFIG_NET_LEGACY=y
CONFIG_NET_RETRY_COUNT=5
CONFIG_NET_TFTP_VARS=y
CONFIG_PHYLIB=y
CONFIG_PHY_ANEG_TIMEOUT=4000
CONFIG_PHY_RESET_DELAY=0
CONFIG_SERVERIP_FROM_PROXYDHCP_DELAY_MS=100
CONFIG_SPL_SYSCON=y
CONFIG_SYSCON=y
CONFIG_SYS_RX_ETH_BUFFER=4
CONFIG_TFTP_BLOCKSIZE=1468
CONFIG_TFTP_TSIZE=y
CONFIG_TFTP_WINDOWSIZE=1
```

## configs/phycore_am62ax_r5_ethboot_defconfig
```kconfig
#include <configs/phycore_am62ax_r5_defconfig>

CONFIG_ARM=y
CONFIG_ARCH_K3=y
CONFIG_SOC_K3_AM62A7=y
CONFIG_TARGET_PHYCORE_AM62AX_R5=y
CONFIG_DEFAULT_DEVICE_TREE="k3-am62a7-r5-phycore-som-2gb"

CONFIG_SPL_GPIO=y
CONFIG_SPL_BOARD_INIT=y
CONFIG_SPL_BSS_MAX_SIZE=0x3100
CONFIG_SPL_DMA=y
CONFIG_SPL_ENV_SUPPORT=y
CONFIG_SPL_ETH=y
CONFIG_SPL_I2C=y
CONFIG_SPL_NET=y
CONFIG_SPL_NET_VCI_STRING="AM62AX U-Boot R5 SPL"
CONFIG_DMA_CHANNELS=y
CONFIG_TI_K3_NAVSS_UDMA=y
CONFIG_DM_I2C=y
CONFIG_SYS_I2C_OMAP24XX=y
CONFIG_PHY_TI_DP83867=y
CONFIG_TI_AM65_CPSW_NUSS=y
# CONFIG_SPI is not set
# CONFIG_SPI_FLASH is not set
# CONFIG_SPL_DM_SPI is not set
# CONFIG_SPL_MMC is not set
# CONFIG_SPL_SPI is not set
# CONFIG_SPL_YMODEM_SUPPORT is not set
```

## configs/socfpga_agilex7m_defconfig
```kconfig
#include <configs/socfpga_agilex_defconfig>

CONFIG_IDENT_STRING="socfpga_agilex7m"
CONFIG_SPL_BSS_START_ADDR=0x1ff00000
CONFIG_TARGET_SOCFPGA_AGILEX7M_SOCDK=y
CONFIG_IDENT_STRING="socfpga_agilex7m"
CONFIG_SPL_CUSTOM_SYS_MALLOC_ADDR=0x1fa00000
CONFIG_SYS_PROMPT="SOCFPGA_AGILEX7M # "
CONFIG_MTDIDS_DEFAULT="nand0=ffb90000.nand.0"
CONFIG_MTDPARTS_DEFAULT="mtdparts=ffb90000.nand.0:2m(u-boot),-(root)"
# CONFIG_DESIGNWARE_SPI is not set
# CONFIG_ENV_IS_IN_UBI is not set
# CONFIG_QSPI_BOOT is not set
# CONFIG_SPL_DESIGNWARE_SPI is not set
# CONFIG_UBIFS_SILENCE_DEBUG_DUMP is not set
# CONFIG_UBIFS_SILENCE_MSG is not set
# CONFIG_UBI_SILENCE_MSG is not set
CONFIG_NR_DRAM_BANKS=1
```

## configs/stm32mp15_dhcom_drc02_basic_defconfig
```kconfig
#include <configs/stm32mp15_dhcom_basic.config>

CONFIG_DEFAULT_DEVICE_TREE="st/stm32mp153c-dhcom-drc02"
```

## configs/stm32mp15_dhcom_picoitx_basic_defconfig
```kconfig
#include <configs/stm32mp15_dhcom_basic.config>

CONFIG_DEFAULT_DEVICE_TREE="st/stm32mp157c-dhcom-picoitx"
```

## configs/stm32mp15_dhcor_avenger96_basic_defconfig
```kconfig
#include <configs/stm32mp15_dhcor_basic.config>

CONFIG_DEFAULT_DEVICE_TREE="st/stm32mp157a-dhcor-avenger96"
```

## configs/stm32mp15_dhcor_testbench_basic_defconfig
```kconfig
#include <configs/stm32mp15_dhcor_basic.config>

CONFIG_DEFAULT_DEVICE_TREE="st/stm32mp151a-dhcor-testbench"
```

## drivers/virtio/Kconfig
```kconfig
# SPDX-License-Identifier: GPL-2.0+
#
# Copyright (C) 2018, Tuomas Tynkkynen <tuomas.tynkkynen@iki.fi>
# Copyright (C) 2018, Bin Meng <bmeng.cn@gmail.com>
#
# VirtIO is a virtualization standard for network and disk device drivers
# where just the guest's device driver "knows" it is running in a virtual
# environment, and cooperates with the hypervisor. This enables guests to
# get high performance network and disk operations, and gives most of the
# performance benefits of paravirtualization. In the U-Boot case, the guest
# is U-Boot itself, while the virtual environment are normally QEMU targets
# like ARM, RISC-V and x86.
#
# See http://docs.oasis-open.org/virtio/virtio/v1.0/virtio-v1.0.pdf for
# the VirtIO specification v1.0.

menu "VirtIO Drivers"

config VIRTIO
	bool
	help
	  This option is selected by any driver which implements the virtio
	  transport, such as CONFIG_VIRTIO_MMIO or CONFIG_VIRTIO_PCI.

config VIRTIO_MMIO
	bool "Platform bus driver for memory mapped virtio devices"
	select VIRTIO
	help
	  This driver provides support for memory mapped virtio
	  platform device driver.

config VIRTIO_PCI
	bool "PCI driver for virtio devices"
	depends on PCI
	select VIRTIO
	help
	  This driver provides support for virtio based paravirtual device
	  drivers over PCI.

config VIRTIO_PCI_LEGACY
	bool "PCI driver for legacy virtio devices"
	depends on PCI
	select VIRTIO
	default VIRTIO_PCI
	help
	  This driver provides support for legacy virtio based paravirtual
	  device drivers over PCI.

config VIRTIO_SANDBOX
	bool "Sandbox driver for virtio devices"
	depends on SANDBOX
	select VIRTIO
	help
	  This driver provides support for Sandbox implementation of virtio
	  transport driver which is used for testing purpose only.

config VIRTIO_SANDBOX_EMUL
	bool "Sandbox MMIO emulator for virtio devices"
	depends on SANDBOX
	select VIRTIO
	help
	  This driver provides an MMIO interface to an emulation of a block
	  device. It is used for testing purpose only.

config VIRTIO_NET
	bool "virtio net driver"
	depends on VIRTIO && NETDEVICES
	help
	  This is the virtual net driver for virtio. It can be used with
	  QEMU based targets.

config VIRTIO_BLK
	bool "virtio block driver"
	depends on VIRTIO
	select BLK
	help
	  This is the virtual block driver for virtio. It can be used with
	  QEMU based targets.

config VIRTIO_RNG
	bool "virtio rng driver"
	depends on DM_RNG
	depends on VIRTIO
	default y
	help
	  This is the virtual random number generator driver. It can be used
	  with QEMU based targets.

config VIRTIO_FS
	bool "virtio filesystem driver"
	depends on VIRTIO && FS
	default y
	help
	  Provides support for virtio-fs which provides access to host files
	  within the guest OS. This needs a user-space helper (virtiofsd) when
	  running QEMU - see https://virtio-fs.gitlab.io/ for details.

	  A specification for the protocol is available at
	  https://docs.oasis-open.org/virtio/virtio/v1.3/virtio-v1.3.html

config VIRTIO_SCSI
	bool "SCSI driver for virtio devices"
	depends on SCSI
	select VIRTIO
	default y
	help
	  This driver provides support for virtio-based paravirtual SCSI. It
	  allows access to storage devices using the

	  A specification for the protocol is available at
	  https://docs.oasis-open.org/virtio/virtio/v1.3/virtio-v1.3.html

config VIRTIO_9P
	bool "virtio 9P transport driver"
	depends on VIRTIO && NET_9P
	help
	  This enables the 9P transport driver over virtio.
	  It can be used with QEMU based targets.

endmenu
```
