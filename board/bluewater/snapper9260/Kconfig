## board/bluewater/snapper9260/Kconfig
```kconfig
if TARGET_SNAPPER9260

config SYS_BOARD
	default "snapper9260"

config SYS_VENDOR
	default "bluewater"

config SYS_CONFIG_NAME
	default "snapper9260"

config SNAPPER9G20
	bool "Snapper 9G20 module"
	select AT91SAM9G20
	help
	  The Snapper module comes with either an AT91SAM9260 or an
	  AT91SAM9G20. Enable this to build for the AT91SAM9G20, which
	  divides its clocks differently. Otherwise U-Boot is built for
	  the AT91SAM9260

endif
```

## common/spl/Kconfig.mon
```kconfig
menu "MON options"
	depends on MON

config MON_TEXT_BASE
	hex "Address that MON is linked and runs at"
	default 0x40000 if ROCKCHIP_RK3399
	help
	  MON runs at a fixed address, which must be out of the way of U-Boot
	  proper and the OS, since it stays in memory while they run.

config MON_MAX_SIZE
	hex "Maximum size of MON, including its stacks"
	default 0x20000
	help
	  The build fails if MON, including its BSS and the stack for each
	  CPU, does not fit in this space from MON_TEXT_BASE

config MON_LDSCRIPT
	string "Linker script for MON"
	default "arch/arm/cpu/armv8/u-boot-mon.lds" if ARM64
	help
	  Linker script used to link MON

config MON_CPUS
	int "Number of CPUs which MON supports"
	default 6 if ROCKCHIP_RK3399
	default 4
	help
	  MON sets aside a stack for each CPU, for use while it handles a
	  request from that CPU

choice
	prompt "How MON finds the devices it sets up"
	default MON_FDT
	help
	  MON sets up devices such as the interrupt controller before it
	  starts U-Boot proper, so it needs to know where they are.

config MON_FDT
	bool "Devicetree"
	help
	  MON has no devicetree of its own, but SPL passes it the address of
	  the one for U-Boot proper. MON looks up its devices there, using
	  libfdt.

config MON_BARE
	bool "Kconfig options"
	help
	  MON takes the addresses of its devices from Kconfig options and does
	  not use a devicetree. This is the smallest build, for use where the
	  memory available to the monitor is very limited.

endchoice

config MON_SWITCH_TO_EL2
	bool "Start U-Boot proper at EL2"
	depends on ARM64
	default y
	help
	  MON normally starts U-Boot proper at EL2 in the non-secure state,
	  as TF-A's BL31 does, so that only MON runs at EL3.

	  Disable this to have MON start U-Boot proper at EL3 instead. U-Boot
	  proper then has access to the secure state, which is useful when
	  working on MON. When U-Boot proper drops to EL2, e.g. to start the
	  OS, it first puts MON back in charge of EL3, so the OS can use MON
	  as before.

	  While U-Boot proper runs at EL3 it cannot call MON, so the 'smc'
	  command and PSCI calls do not work there.

config MON_LIBGENERIC_SUPPORT
	bool
	default y if MON_FDT
	help
	  MON uses a few of the functions in lib/, such as those of libfdt, so
	  that directory is built for it.

config MON_OF_LIBFDT
	bool
	default y if MON_FDT
	help
	  This builds libfdt for MON, so that it can read the devicetree which
	  SPL passes to it.

config MON_OF_LIBFDT_ASSUME_MASK
	hex
	depends on MON_OF_LIBFDT
	default 0
	help
	  This is the mask of conditions which libfdt assumes about the
	  devicetree in MON. With 0 it assumes nothing, so it checks everything
	  it reads. See FDT_ASSUME_PERFECT, etc. in libfdt_internal.h

if ARM64

config MON_GICD_BASE
	hex "Address of the GICv3 distributor"
	depends on MON_BARE
	default 0xfee00000 if ROCKCHIP_RK3399
	help
	  MON sets up the secure side of the interrupt controller, so that
	  U-Boot and the OS can use it from the non-secure side. With MON_FDT
	  this address comes from the devicetree.

config MON_GICR_BASE
	hex "Address of the GICv3 redistributors"
	depends on MON_BARE
	default 0xfef00000 if ROCKCHIP_RK3399
	help
	  MON finds the redistributor of each CPU from this address. With
	  MON_FDT it comes from the devicetree.

endif

endmenu
```

## scripts/kconfig/tests/dump/Kconfig
```kconfig
config MODULES
	bool "Modules"
	option modules

config BOOL
	bool "A bool" if MODULES
	default y if !TRI
	select SELECTED if TRI
	imply IMPLIED
	help
	  This is the help.

	  It has two paragraphs.

config TRI
	tristate "A tristate"
	depends on MODULES

config SELECTED
	bool

config IMPLIED
	bool "Implied"

config STR
	string "A string"
	default "hello \"there\""

config INT
	int "An int"
	range 1 HEX if BOOL
	default 3

config HEX
	hex "A hex"
	default 0x10

comment "A comment"
	depends on BOOL

menu "A menu"
	visible if TRI
	depends on BOOL

config IN_MENU
	bool "In a menu"

if IMPLIED || STR = "a"

config IN_IF
	bool "In an if block"
	depends on HEX > 0x5

endif

endmenu

menuconfig MENUCFG
	bool "A menuconfig"

config SUB
	bool "Under the menuconfig"
	depends on MENUCFG

choice
	prompt "A choice"
	default CH2
	optional

config CH1
	bool "One"

config CH2
	bool "Two"
	depends on BOOL

endchoice

config BOOL
	default n if STR != ""
```

## scripts/kconfig/tests/err_phases/Kconfig
```kconfig
config SPL
	bool "Enable SPL"

config SERIAL
	bool "Serial"
	phases all

config SERIAL
	default y

choice
	prompt "Console"

config CONSOLE_UART
	bool "UART"
	phases all

config CONSOLE_NONE
	bool "None"

endchoice

config DM
	bool "Driver model"
	phases all

config SPL_DM
	bool "Driver model in SPL"
```

## scripts/kconfig/tests/err_phases_value/Kconfig
```kconfig
config SPL
	bool "Enable SPL"

config SIZE
	int "Size"
	phases ppl
	default 8

config RANGED
	int "Has a range"
	phases all
	range 1 SIZE

config USES_SIZE
	int "Default from another option"
	phases all
	default SIZE

config COMPARES
	bool "Compares another option"
	phases all
	depends on SIZE > 4
```

## scripts/kconfig/tests/phases/Kconfig
```kconfig
config SPL
	bool "Enable SPL"

config TPL
	bool "Enable TPL"

config ARCH_X
	bool "Architecture X"

config DM
	bool "Driver model"
	phases all

config PRINTF
	bool "printf()"
	phases ppl spl

config SERIAL
	bool "Serial"
	phases all
	depends on DM
	select PRINTF

config SERIAL
	phases !ppl
	default y

config MAX_SIZE
	hex "Maximum size"
	phases spl tpl
	default 0x1000

config GLOBAL
	bool "Same in every phase, except for a twin"

config SPL_GLOBAL
	bool "Twin written out by hand"

config USES_GLOBAL
	bool "Depends on an option with no phases"
	phases all
	depends on GLOBAL

config PRIMARY_ONLY
	bool "Only in the primary phase"
	phases ppl
	default y

menu "Menu"
	depends on DM

config IN_MENU
	bool "In a menu"
	phases all

endmenu

if SERIAL

config IN_IF
	bool "In an if block"
	phases all
	default y

endif

config BY_ARCH
	bool "Default set by the architecture"
	phases all

if ARCH_X

config BY_ARCH
	phases all
	default y

endif
```

## scripts/kconfig/tests/warn_phases_select/Kconfig
```kconfig
config SPL
	bool "Enable SPL"

config TPL
	bool "Enable TPL"

config PLAIN
	bool "Same in every phase"

config ALSO_PLAIN
	bool "Also the same in every phase"

config HAS_TWIN
	bool "Has a twin written out by hand"

config SPL_HAS_TWIN
	bool "Twin for SPL"

config NET
	bool "Networking"
	phases all
	select PLAIN
	imply PLAIN
	select PPL_ALSO_PLAIN
	select HAS_TWIN

config PRIMARY_NET
	bool "Networking in the primary phase"
	phases ppl
	select PLAIN
```

## scripts/kconfig/tests/xpl/Kconfig
```kconfig
config SPL
	bool "Enable SPL"

config TPL
	bool "Enable TPL"

config SERIAL
	bool "Serial"

config SPL_SERIAL
	bool "Serial in SPL"

config CMDLINE
	bool "Command line"

config NET
	bool "Networking"

config TPL_MAX_SIZE
	hex "Maximum size of TPL"
```

## scripts/kconfig/tests/xpl_primary_only/Kconfig
```kconfig
config FOO
	bool "In every phase"
	phases all

config BAR
	bool "Only in the primary phase"
	phases ppl
```
