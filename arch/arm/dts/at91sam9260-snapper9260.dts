// SPDX-License-Identifier: GPL-2.0+
/*
 * Bluewater Systems Snapper 9260 module
 *
 * Copyright 2026 Simon Glass <sjg@chromium.org>
 */

/dts-v1/;
#include "at91sam9260.dtsi"
#include "at91-snapper9260.dtsi"

/ {
	model = "Bluewater Systems Snapper 9260";
	compatible = "bluewater,snapper9260", "atmel,at91sam9260",
		"atmel,at91sam9";
};
